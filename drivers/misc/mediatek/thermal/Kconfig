## drivers/misc/mediatek/thermal/Kconfig
```kconfig
config MTK_THERMAL_PA_VIA_ATCMD
	bool "Thermal switch for query modem RF temp"
	help
	  Internal switch for thermal management
	  to query modem RF temperature
	  via AT command.
	  (RIL sockets)

config CLATM_CHOOSE_HIGHER_TARGET_TJ
	bool "adaptive cooler will choose the one who has higher target Tj"
	help
	  Change ATM decide TTj logic.
	  It will choose the adaptive cooler with higher Target Tj
	  and use the higher trip point as target Tj
	  when more than one adaptive active.
	default n

config VS_BACKLIGHT_COOLER
	bool "Virtual Sensor backlight cooler"
	default n

config THERMAL_abc123
	bool "THERMAL_abc123"
	default n
	help
	  For abc123 specific configurations for thermal related.

config THERMAL_abc123
	bool "THERMAL_abc123"
	default n
	help
	  For abc123 specific configurations for thermal related.

config VS_BCCT_COOLER
	bool "Virtual Sensor battery current cooler"
	default n

config THERMAL_abc123
	bool "THERMAL_abc123"
	default n
	help
	  For abc123 specific configurations for thermal related.

config THERMAL_KARNAK
	bool "THERMAL_KARNAK"
	default n
	help
	  For KARNAK specific configurations for thermal related.


config THERMAL_KAYAK
	bool "THERMAL_KAYAK"
	default n
	help
	  For KAYAK specific configurations for thermal related.

config THERMAL_ROOK
	bool "THERMAL_ROOK"
	default n
	help
	  For ROOK specific configurations for thermal related.

config THERMAL_CHECKERS
	bool "THERMAL_CHECKERS"
	default n
	help
	  For CHECKERS specific configurations for thermal related.

config THERMAL_DOUGLAS
        bool "THERMAL_DOUGLAS"
        default n
        help
          For DOUGLAS specific configurations for thermal related.

config THERMAL_GIZA
        bool "THERMAL_GIZA"
        default n
        help
          For GIZA specific configurations for thermal related.

config THERMAL_CROWN
	bool "THERMAL_CROWN"
	default n
	help
	  For CROWN specific configurations for thermal related.

config THERMAL_CRONOS
	bool "THERMAL_CRONOS"
	default n
	help
	  For CRONOS specific configurations for thermal related.

source "drivers/misc/mediatek/thermal/tmp103/Kconfig"
```

## drivers/staging/amazon/Kconfig
```kconfig
menu "Amazon"

config ROOK
	bool "Rook MTK platform project"
	help
	isolate amazon Rook changes for MTK Platform

config CHECKERS
	bool "Checkers MTK platform project"
	help
	isolate amazon Checkers changes for MTK Platform

config DOUGLAS
	bool "Douglas MTK platform project"
	help
	isolate amazon Douglas changes for MTK Platform

config GIZA
	bool "Giza MTK platform project"
	help
	isolate amazon Giza changes for MTK Platform

config CROWN
	bool "Crown MTK platform project"
	help
	isolate amazon Crown changes for MTK Platform

config CRONOS
	bool "Cronos MTK platform project"
	help
	isolate amazon Cronos changes for MTK Platform

endmenu
```
